/*
*******************************************************************************************************
*
* File Name : ntc.c
* Version   : V1.0
* Author    : mzy2364
* brief     : ntc table
* 
*******************************************************************************************************
*/


/* INCLUDE FILES ------------------------------------------------------------------------------------*/
#include "adc_simple.h"

/* DEFINES ------------------------------------------------------------------------------------------*/
#define NTC_TABLE_LEN   176

/* VARIABLES ----------------------------------------------------------------------------------------*/
int16_t ntc_table[NTC_TABLE_LEN][2] = {
{-50,4038},
{-49,4033},
{-48,4029},
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{125,132}
};


/* FUNCTION -----------------------------------------------------------------------------------------*/

/**
 * 使用NTC查表计算温度
 * @param ntc_adc NTC对应的ADC采集值
 * @return 温度值，单位为摄氏度
 */
float calculate_temperature_float(uint16_t ntc_adc)
{
	int low = 0;
	int high = NTC_TABLE_LEN - 1;
	while (low <= high)
	{
		int mid = (low + high) / 2;
		if (ntc_adc > ntc_table[mid][1])
		{
			high = mid - 1;
		} 
		else if (ntc_adc < ntc_table[mid][1])
		{
			low = mid + 1;
		} 
		else
		{
			return ntc_table[mid][0];
		}
	}
	// 此时 low 和 high 分别指向最接近 ntc_adc 的两个电阻值
	if (low == 0)
	{
		return ntc_table[0][0];
	}
	else if (high == NTC_TABLE_LEN - 1)
	{
		return ntc_table[NTC_TABLE_LEN - 1][0];
	}
	else
	{
		float x0 = ntc_table[low - 1][0];
		float y0 = ntc_table[low - 1][1];
		float x1 = ntc_table[low][0];
		float y1 = ntc_table[low][1];
		return x0 + (x1 - x0) * (ntc_adc - y0) / (y1 - y0);
	}
}


/* LOCAL FUNCTION -----------------------------------------------------------------------------------*/
/**
  * @brief 
  * @param None
  * @retval None
  */


/***************************************** (END OF FILE) *********************************************/
